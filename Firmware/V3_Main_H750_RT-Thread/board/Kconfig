## Firmware/V3_Main_H750_RT-Thread/board/Kconfig
```kconfig
menu "Hardware Drivers Config"

config SOC_STM32H750XB
    bool
    select SOC_SERIES_STM32H7
    select RT_USING_COMPONENTS_INIT
    select RT_USING_USER_MAIN
    default y

menu "Onboard Peripheral"

    config JSIR_CARD_USING_NAND
        bool "Enable NAND FLASH (W25N01GVZEIG)"
        select BSP_USING_SPI
        select BSP_USING_SPI4
        select RT_USING_FAL
        default n

    config JSIR_CARD_USING_WIFI
        bool "Enable WIFI (AP6212)"
        select JSIR_CARD_USING_NAND
        select RT_USING_SAL
        select BSP_USING_SDIO
        select BSP_USING_SDIO2
        select RT_USING_WIFI
        select RT_USING_LWIP
        default n

endmenu

menu "On-chip Peripheral Drivers"

    config BSP_USING_GPIO
        bool "Enable GPIO"
        select RT_USING_PIN
        default y

    menuconfig BSP_USING_UART
        bool "Enable UART"
        default y
        select RT_USING_SERIAL
        if BSP_USING_UART
            config BSP_USING_UART7
                bool "Enable UART7"
                default y
        endif

    menuconfig BSP_USING_SPI
        bool "Enable SPI"
        default n
        select RT_USING_SPI
        if BSP_USING_SPI
            config BSP_USING_SPI4
                bool "Enable SPI4"
                default y
        endif

    menuconfig BSP_USING_SDIO
        bool "Enable SDIO"
        default n
        select RT_USING_SDIO
        if BSP_USING_SDIO
            config BSP_USING_SDIO2
                bool "Enable SDIO2"
                default y
        endif
    
    source "$BSP_DIR/libraries/HAL_Drivers/drivers/Kconfig"

endmenu

menu "Board extended module Drivers"

endmenu

endmenu
```
